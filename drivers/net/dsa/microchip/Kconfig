## drivers/net/dsa/microchip/Kconfig
```kconfig
menuconfig MICROCHIP_KSZ
	tristate "Microchip KSZ series switch support"
	depends on NET_DSA
	select NET_DSA_TAG_KSZ
	help
	  This driver adds support for Microchip KSZ switch chips.

config MICROCHIP_KSZ_SPI_DRIVER
	tristate "KSZ series SPI connected switch driver"
	depends on MICROCHIP_KSZ && SPI
	help
	  Select to enable support for registering switches configured through SPI.

config	MICROCHIP_KSZ_9896C
	tristate "KSZ9896c switch driver"
        depends on  I2C
	help
	  Support for KSZ9896C.




	
```

## drivers/tty/serial/wk2xxx/Kconfig
```kconfig
config SERIAL_WK2XXX
        tristate "serial wk2xxx"
        depends on SERIAL_8250 
        help
          Say Y here if you have wk2xxx serial. If unsure, say N.
```
